#include <SPI.h>

// Adaptado de https://github.com/dquadros/LCD12864
// Usa PSRAM só para mostrar que dá para usar

// Connections
const int pinCS = 7;    // GPIO7
const int pinRES = 6;   // GPIO6
const int pinRS = 5;    // GPIO5
#define LCD_SPI SPI

// RS pin convention
#define DATA HIGH
#define CMD  LOW

// SPI Configuration
SPISettings SPI_CONFIG(10000000, MSBFIRST, SPI_MODE3);

// ST7565R Commands
#define ST7565R_DISPLAY_OFF 0xAE
#define ST7565R_DISPLAY_ON  0xAF
#define ST7565R_SET_DISP_START_LINE 0x40
#define ST7565R_SET_PAGE    0xB0
#define ST7565R_SET_COLUMN_UPPER  0x10
#define ST7565R_SET_COLUMN_LOWER  0x00
#define ST7565R_SET_ADC_NORMAL  0xA0
#define ST7565R_SET_ADC_REVERSE 0xA1
#define ST7565R_SET_ALLPTS_NORMAL 0xA4
#define ST7565R_SET_ALLPTS_ON  0xA5
#define ST7565R_SET_BIAS_9 0xA2 
#define ST7565R_SET_BIAS_7 0xA3
#define ST7565R_RMW  0xE0
#define ST7565R_RMW_CLEAR 0xEE
#define ST7565R_INTERNAL_RESET  0xE2
#define ST7565R_SET_COM_NORMAL  0xC0
#define ST7565R_SET_COM_REVERSE  0xC8
#define ST7565R_SET_POWER_CONTROL  0x28
#define ST7565R_SET_RESISTOR_RATIO  0x20
#define ST7565R_SET_VOLUME_FIRST  0x81
#define ST7565R_SET_VOLUME_SECOND  0
#define ST7565R_SET_STATIC_OFF  0xAC
#define ST7565R_SET_STATIC_ON  0xAD
#define ST7565R_SET_STATIC_REG  0x0
#define ST7565R_SET_BOOSTER_FIRST  0xF8
#define ST7565R_SET_BOOSTER_234  0
#define ST7565R_SET_BOOSTER_5  1
#define ST7565R_SET_BOOSTER_6  3
#define ST7565R_NOP  0xE3
#define ST7565R_TEST  0xF0

// Screen size
#define LCD_WIDTH    128
#define LCD_HEIGHT   64

// Screen buffer
uint8_t *screenbuf;

// Display initialization commands
byte cmdInit[] =
{
  // cmd                              // delay
  ST7565R_SET_BIAS_7,                 0, 
  ST7565R_SET_ADC_NORMAL,             0,
  ST7565R_SET_COM_NORMAL,             0,
  ST7565R_SET_DISP_START_LINE,        0,
  ST7565R_SET_POWER_CONTROL | 0x4,    50,
  ST7565R_SET_POWER_CONTROL | 0x6,    50,
  ST7565R_SET_POWER_CONTROL | 0x7,    10,
  ST7565R_SET_RESISTOR_RATIO | 0x6,   0,
  ST7565R_DISPLAY_ON,                 0,
  ST7565R_SET_ALLPTS_NORMAL,          0,
  ST7565R_SET_VOLUME_FIRST,           0,
  ST7565R_SET_VOLUME_SECOND | 13,     0
};

/**
 * ssd1306xled_font8x16 is by Neven Boyanov
 *
 * @created: 2014-08-12
 * @author: Neven Boyanov
 *
 * Copyright (c) 2015 Neven Boyanov, Tinusaur Team. All Rights Reserved.
 * Distributed as open source software under MIT License, see LICENSE.txt file.
 * Please, as a favour, retain the link http://tinusaur.org to The Tinusaur Project.
 *
 * Source code available at: https://bitbucket.org/tinusaur/ssd1306xled
 *
 * Vertically inverted by Daniel Quadros
 */
const uint8_t font8x16 []=
{
    0x00, 0x00, 0x00, 0x00, 0x00, 0x00, 0x00, 0x00, 0x00, 0x00, 0x00, 0x00, 0x00, 0x00, 0x00, 0x00, //   0
    0x00, 0x00, 0x00, 0xCC, 0x0C, 0x00, 0x00, 0x00, 0x00, 0x00, 0x00, 0x1F, 0x00, 0x00, 0x00, 0x00, // ! 1
    0x00, 0x00, 0x00, 0x00, 0x00, 0x00, 0x00, 0x00, 0x00, 0x08, 0x30, 0x60, 0x08, 0x30, 0x60, 0x00, // " 2
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    0x40, 0x40, 0x80, 0xF0, 0x80, 0x40, 0x40, 0x00, 0x02, 0x02, 0x01, 0x0F, 0x01, 0x02, 0x02, 0x00, //   95
};

// Initialize the display
void Display_init()
{
  // Init interfaces
  LCD_SPI.begin();
  pinMode(pinRES, OUTPUT);
  digitalWrite(pinRES, LOW);
  pinMode(pinRS, OUTPUT);
  digitalWrite(pinRS, CMD);
  pinMode(pinCS, OUTPUT);
  digitalWrite(pinCS, HIGH);

  // Reset controller
  digitalWrite (pinRES, LOW);
  delay (500);
  digitalWrite (pinRES, HIGH);
  delay (100);
  
  // Configure controller and clean the screen
  Display_sendcmd (cmdInit, sizeof(cmdInit)/2);
  screenbuf = (uint8_t *) ps_malloc(LCD_HEIGHT*LCD_WIDTH/8);
  memset(screenbuf, 0x00, LCD_HEIGHT*LCD_WIDTH/8);
  Display_update();
}

// Send current buffer to the display
void Display_update()
{
  uint8_t *pbuf = screenbuf;

  LCD_SPI.beginTransaction(SPI_CONFIG);

  for (byte p = 0; p < LCD_HEIGHT/8; p++) {
    Display_sendcmd(ST7565R_SET_PAGE | p);
    Display_sendcmd(ST7565R_SET_COLUMN_UPPER | 0);
    Display_sendcmd(ST7565R_SET_COLUMN_LOWER | 0);
    digitalWrite(pinCS, LOW);
    digitalWrite(pinRS, DATA);
    for (byte c = 0; c < LCD_WIDTH; c++) {
      LCD_SPI.transfer(*pbuf++);
    }
    digitalWrite(pinCS, HIGH);
  }

  LCD_SPI.endTransaction();
}

// Write string s starting at line l (0-3) collumn c (0-16)
void Display_str(char *str, int l, int c) {
  while (*str) {
    Display_chr(*str, l, c);
    if (++c == 16) {
      c = 0;
      if (++l == 4) {
        l = 0;
      }
    }
    str++;
  }
}

// Write char chr at line l (0-3) collumn c (0-16)
void Display_chr(char chr, int l, int c) {
  byte *pgc = (byte *) (font8x16 + ((chr - 0x20) << 4));
  l = (3-l) << 1;
  c = c << 3;
  byte *psc = screenbuf + l*LCD_WIDTH + c;
  for (int i = 0; i < 8; i++) {
    *psc++ = *pgc++;
  }
  psc = screenbuf + (l+1)*LCD_WIDTH + c;
  for (int i = 0; i < 8; i++) {
    *psc++ = *pgc++;
  }
}

// Send a sequence of commands to the display, with delays
void Display_sendcmd (byte *cmd, int nCmds)
{
  LCD_SPI.beginTransaction(SPI_CONFIG);
  digitalWrite(pinCS, LOW);
  digitalWrite(pinRS, CMD);
  for (int i = 0; i < nCmds*2; i+=2)
  {
    LCD_SPI.transfer(cmd[i]);
    if (cmd[i+1] != 0) {
      delay(cmd[i+1]);
    }
  }
  digitalWrite(pinCS, HIGH);
  LCD_SPI.endTransaction();
}

// Send a command byte to the display
void Display_sendcmd (byte cmd)
{
  digitalWrite(pinCS, LOW);
  digitalWrite(pinRS, CMD);
  LCD_SPI.transfer(cmd);
  digitalWrite(pinCS, HIGH);
}

